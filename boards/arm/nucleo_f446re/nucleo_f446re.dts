/*
 * Copyright (c) 2017 Linaro Limited
 *
 * SPDX-License-Identifier: Apache-2.0
 */

/dts-v1/;
#include <st/stm32f446re.dtsi>

/ {
	model = "STMicroelectronics STM32F446RE-NUCLEO board";
	compatible = "st,stm32f446re-nucleo", "st,stm32f446";

	chosen {
		zephyr,console = &uart4;
		zephyr,sram = &sram0;
		zephyr,flash = &flash0;
	};
};

&uart4 {
	current-speed = <115200>;
	pinctrl-0 = <&uart4_pins_a>;
	pinctrl-names = "default";
	status = "ok";
};

&uart5 {
	current-speed = <115200>;
	pinctrl-0 = <&uart5_pins_a>;
	pinctrl-names = "default";
	status = "ok";
};
