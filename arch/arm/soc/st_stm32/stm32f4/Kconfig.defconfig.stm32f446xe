## arch/arm/soc/st_stm32/stm32f4/Kconfig.defconfig.stm32f446xe
```kconfig
# Kconfig - ST STM32F446XE MCU configuration options
#
# Copyright (c) 2016 Linaro Limited.
#
# SPDX-License-Identifier: Apache-2.0
#

if SOC_STM32F446XE

config SOC
	string
	default stm32f446xe

config NUM_IRQS
	int
	default 85

endif # SOC_STM32F446XE
```

## boards/arm/nucleo_f446re/Kconfig.board
```kconfig
# Kconfig - NUCLEO-64 F411RE board configuration
#
# Copyright (c) 2016 Matthias Boesl
#
# SPDX-License-Identifier: Apache-2.0
#

config BOARD_NUCLEO_F446RE
	bool "NUCLEO-64 F446RE Development Board"
	depends on SOC_STM32F446RE
```

## boards/arm/nucleo_f446re/Kconfig.defconfig
```kconfig
# Kconfig - NUCLEO-64 F411RE board configuration
#
# Copyright (c) 2016 Matthias Boesl
#
# SPDX-License-Identifier: Apache-2.0
#

if BOARD_NUCLEO_F446RE

config BOARD
	default nucleo_f446re

endif # BOARD_NUCLEO_F446RE
```

## drivers/serial/Kconfig.rs485_sam
```kconfig
# Kconfig - Atmel SAM RS485 configuration options
#
# Copyright (c) 2017 xxxxxxxxxxxxx
# SPDX-License-Identifier: Apache-2.0
#

menuconfig RS485_SAM
	bool "Atmel SAM MCU family RS485 driver"
	default n 
	help
	  This option enables the USARTx driver for Atmel SAM MCUs.
```
